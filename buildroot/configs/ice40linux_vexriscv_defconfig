## buildroot/configs/ice40linux_vexriscv_defconfig
```kconfig
BR2_riscv=y
BR2_riscv_custom=y
BR2_RISCV_32=y
BR2_CCACHE=y
BR2_PACKAGE_HOST_LINUX_HEADERS_CUSTOM_5_12=y
BR2_TARGET_GENERIC_HOSTNAME="ice40"
BR2_TARGET_GENERIC_ISSUE="Welcome to iCE40linux"
# BR2_TARGET_GENERIC_REMOUNT_ROOTFS_RW is not set
BR2_ROOTFS_OVERLAY="$(BR2_EXTERNAL_ICE40LINUX_VEXRISCV_PATH)/board/ice40linux_vexriscv/rootfs_overlay"
BR2_LINUX_KERNEL=y
BR2_LINUX_KERNEL_CUSTOM_GIT=y
BR2_LINUX_KERNEL_CUSTOM_REPO_URL="git://github.com/smunaut/iCE40linux-kernel.git"
BR2_LINUX_KERNEL_CUSTOM_REPO_VERSION="5f5c810dfa05a0dc45cb6c11ca1468d32d019de0"
BR2_LINUX_KERNEL_USE_CUSTOM_CONFIG=y
BR2_LINUX_KERNEL_CUSTOM_CONFIG_FILE="$(BR2_EXTERNAL_ICE40LINUX_VEXRISCV_PATH)/board/ice40linux_vexriscv/linux.config"
BR2_PACKAGE_ASCII_INVADERS=y
BR2_PACKAGE_XORCURSES=y
BR2_PACKAGE_MICROPYTHON=y
BR2_PACKAGE_MICROPYTHON_LIB=y
BR2_PACKAGE_LRZSZ=y
# BR2_PACKAGE_URANDOM_SCRIPTS is not set
BR2_TARGET_ROOTFS_CPIO=y
BR2_TARGET_ROOTFS_UBI=y
BR2_TARGET_ROOTFS_UBI_PEBSIZE=0x10000
BR2_TARGET_ROOTFS_UBI_SUBSIZE=0
BR2_TARGET_ROOTFS_UBIFS_LEBSIZE=0xff80
BR2_TARGET_ROOTFS_UBIFS_MINIOSIZE=0x1
BR2_TARGET_ROOTFS_UBIFS_MAXLEBCNT=256
```
